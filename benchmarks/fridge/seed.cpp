#include <algorithm>
#include <memory>

#include "daisy_seed.h"
#include "workload.hpp"

using namespace fridge::benchmark;

namespace {
daisy::DaisySeed hardware;
alignas(fridge::sound::Sound) char DSY_SDRAM_BSS
    sound_storage[sizeof(fridge::sound::Sound)];
alignas(Workload) char workload_storage[sizeof(Workload)];
fridge::sound::Sound* sound;
Workload* workload;
volatile uint32_t blocks = 0;
uint64_t total_cycles = 0;
uint32_t max_cycles = 0;
uint32_t overruns = 0;
uint32_t budget_cycles = 0;
float checksum = 0;
constexpr uint32_t kBlocks = fridge::kSampleRateHz;

void Callback(daisy::AudioHandle::InputBuffer input,
              daisy::AudioHandle::OutputBuffer output, size_t size) {
  // Input is generated by the shared deterministic workload.
  const uint32_t start = DWT->CYCCNT;
  for (size_t i = 0; i < size; ++i) {
    output[0][i] = output[1][i] = 0;  // Benchmark is silent at the audio jack.
    if (blocks < kBlocks) {
      const auto result = workload->Tick(*sound);
      checksum += result.left + result.right;
    }
  }
  const uint32_t elapsed = DWT->CYCCNT - start;
  if (blocks < kBlocks) {
    total_cycles += elapsed;
    max_cycles = std::max(max_cycles, elapsed);
    overruns += elapsed > budget_cycles;
    blocks = blocks + 1;
  }
}
}  // namespace

int main() {
  hardware.Init();  // Same 400 MHz default as the production firmware.
  static_assert(fridge::kSampleRateHz == 48000);
  static_assert(sizeof(fridge::sound::Sound) <= 64 * 1024 * 1024);
  hardware.SetAudioSampleRate(daisy::SaiHandle::Config::SampleRate::SAI_48KHZ);
  hardware.SetAudioBlockSize(kBlockSize);
  hardware.StartLog(true);
  CoreDebug->DEMCR |= CoreDebug_DEMCR_TRCENA_Msk;
  DWT->LAR = 0xC5ACCE55;  // Unlock the Cortex-M7 trace unit.
  DWT->CYCCNT = 0;
  DWT->CTRL |= DWT_CTRL_CYCCNTENA_Msk;
  const uint32_t initial_cycles = DWT->CYCCNT;
  hardware.DelayMs(1);
  if (DWT->CYCCNT == initial_cycles) {
    hardware.PrintLine("ERROR: cycle counter did not start");
    while (true) {
      hardware.DelayMs(1000);
    }
  }
  budget_cycles = SystemCoreClock / fridge::kSampleRateHz * kBlockSize;
  hardware.PrintLine("core_hz=%lu, sample_hz=%lu, block=%lu, budget_cycles=%lu",
                     static_cast<unsigned long>(SystemCoreClock),
                     static_cast<unsigned long>(fridge::kSampleRateHz),
                     static_cast<unsigned long>(kBlockSize),
                     static_cast<unsigned long>(budget_cycles));
  hardware.PrintLine(
      "scenario,mean_cycles,max_cycles,overruns,finite,checksum");
  for (size_t scenario = 0; scenario < kScenarios.size(); ++scenario) {
    sound = std::construct_at(
        reinterpret_cast<fridge::sound::Sound*>(sound_storage));
    workload = std::construct_at(reinterpret_cast<Workload*>(workload_storage),
                                 scenario);
    blocks = 0;
    total_cycles = 0;
    max_cycles = overruns = 0;
    checksum = 0;
    hardware.StartAudio(Callback);
    while (blocks < kBlocks) {
      hardware.DelayMs(1);
    }
    hardware.StopAudio();
    hardware.PrintLine("%s,%lu,%lu,%lu,%d," FLT_FMT3, kScenarios[scenario],
                       static_cast<unsigned long>(total_cycles / kBlocks),
                       static_cast<unsigned long>(max_cycles),
                       static_cast<unsigned long>(overruns),
                       std::isfinite(checksum), FLT_VAR3(checksum));
    std::destroy_at(workload);
    std::destroy_at(sound);
  }
  while (true) {
    hardware.DelayMs(1000);
  }
}
